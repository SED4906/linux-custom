## Documentation/devicetree/bindings/input/touchscreen/focaltech,fts5452.yaml
```yaml
# SPDX-License-Identifier: (GPL-2.0-only OR BSD-2-Clause)
%YAML 1.2
---
$id: http://devicetree.org/schemas/input/touchscreen/focaltech...
$schema: http://devicetree.org/meta-schemas/core.yaml#

title: Focaltech FTS I2C Touchscreen Controller

maintainers:
  - Joel Selvaraj <joelselvaraj.oss@gmail.com>
  - Caleb Connolly <caleb@connolly.tech>

allOf:
  - $ref: touchscreen.yaml#

properties:
  compatible:
    enum:
      - focaltech,fts5452
      - focaltech,fts8719

  reg:
    const: 0x38

  interrupts:
    maxItems: 1

  reset-gpios:
    maxItems: 1

  avdd-supply:
    description: regulator supplying analog power (2.6V to 3.3V).

  vddio-supply:
    description: regulator supplying IO power (1.8V).

unevaluatedProperties: false

required:
  - compatible
  - reg
  - touchscreen-size-x
  - touchscreen-size-y

examples:
  - |
    #include <dt-bindings/interrupt-controller/irq.h>
    #include <dt-bindings/gpio/gpio.h>
    i2c {
      #address-cells = <1>;
      #size-cells = <0>;

      touchscreen@38 {
        compatible = "focaltech,fts5452";
        reg = <0x38>;

        interrupt-parent = <&tlmm>;
        interrupts = <125 IRQ_TYPE_EDGE_FALLING>;
        reset-gpios = <&tlmm 99 GPIO_ACTIVE_LOW>;

        avdd-supply = <&vreg_l28a_3p0>;
        vddio-supply = <&vreg_l14a_1p88>;

        pinctrl-names = "default", "suspend";
        pinctrl-0 = <&ts_int_active &ts_reset_active>;
        pinctrl-1 = <&ts_int_suspend &ts_reset_suspend>;

        touchscreen-size-x = <1080>;
        touchscreen-size-y = <2160>;
      };
    };
```
